## os/various/zephyr_bindings/Kconfig
```kconfig
# ChibiOS - Copyright (C) 2006-2026 Giovanni Di Sirio.
# SPDX-License-Identifier: Apache-2.0

config CHIBIOS_SB_TIMER
	bool "ChibiOS sandbox system timer"
	default y
	depends on CHIBIOS_SB && SYS_CLOCK_EXISTS
	select TICKLESS_CAPABLE
	select TIMER_READS_ITS_FREQUENCY_AT_RUNTIME
	select SYSTEM_TIMER_HAS_DISABLE_SUPPORT
	help
	  System timer based on the host system time and on the host alarm,
	  the frequency is the one of the host system time.
```

## os/various/zephyr_bindings/boards/chibios/chibios_sb/Kconfig.chibios_sb
```kconfig
# ChibiOS - Copyright (C) 2006-2026 Giovanni Di Sirio.
# SPDX-License-Identifier: Apache-2.0

config BOARD_CHIBIOS_SB
	select SOC_CHIBIOS_SB
```

## os/various/zephyr_bindings/boards/chibios/chibios_sb/board.yml
```yaml
board:
  name: chibios_sb
  full_name: ChibiOS sandbox
  socs:
    - name: chibios_sb
```

## os/various/zephyr_bindings/boards/chibios/chibios_sb/chibios_sb_defconfig
```kconfig
# ChibiOS - Copyright (C) 2006-2026 Giovanni Di Sirio.
# SPDX-License-Identifier: Apache-2.0

CONFIG_BUILD_OUTPUT_BIN=y
```

## os/various/zephyr_bindings/soc/chibios/sb/Kconfig
```kconfig
# ChibiOS - Copyright (C) 2006-2026 Giovanni Di Sirio.
# SPDX-License-Identifier: Apache-2.0

config SOC_CHIBIOS_SB
	select CHIBIOS_SB
	select CPU_HAS_FPU
```

## os/various/zephyr_bindings/soc/chibios/sb/Kconfig.soc
```kconfig
# ChibiOS - Copyright (C) 2006-2026 Giovanni Di Sirio.
# SPDX-License-Identifier: Apache-2.0

config SOC_CHIBIOS_SB
	bool
	help
	  ChibiOS sandbox, the code runs unprivileged on an ARMv7-M or ARMv8-M
	  Mainline core.

config SOC
	default "chibios_sb" if SOC_CHIBIOS_SB
```
